## dts/bindings/sensor/bst,bme680.yaml
```yaml
#
# Copyright (c) 2018, Bosch Sensortec GmbH
#
# SPDX-License-Identifier: Apache-2.0
#
---
title: BME680 integrated environmental sensor
id: bst,bme680
version: 0.1

description: >
    The BME680 is an integrated environmental sensor that measures
    temperature, pressure, humidity and air quality

inherits:
    !include i2c-device.yaml

properties:
    compatible:
      constraint: "bst,bme680"
...
```
